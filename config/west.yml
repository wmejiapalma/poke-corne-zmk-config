## config/west.yml
```yaml
manifest:
  remotes:
    - name: urob
      url-base: https://github.com/urob
  projects:
    - name: zmk
      remote: urob
      revision: v0.3.0
      import: app/west.yml
  self:
    path: config
```
